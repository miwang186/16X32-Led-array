#include <STC89C5xRC.H>
#include "led_array.h"

/*按键*/
#define KEY_ALL_PIN	P1

#define	PAGE_MAX_COUNT	3

uint8_t code school_log_picture[] = 
{
	0x00,0x00,0x1E,0x3C,0x70,0x07,0x40,0x01,0x4A,0x29,0x4A,0x29,0x7A,0x2F,0x02,0x20,
	0xFA,0x3F,0x02,0x20,0x7A,0x2F,0x4A,0x29,0x48,0x29,0x40,0x01,0x78,0x07,0x0E,0x3C,/*"未命名文件",0*/
	0x00,0x00,0x1E,0x3C,0x70,0x07,0x40,0x01,0x4A,0x29,0x4A,0x29,0x7A,0x2F,0x02,0x20,
	0xFA,0x3F,0x02,0x20,0x7A,0x2F,0x4A,0x29,0x48,0x29,0x40,0x01,0x78,0x07,0x0E,0x3C,/*"未命名文件",0*/
};

uint8_t code school_ch_name_font[] = 
{
	0x20,0x40,0x20,0xC0,0x24,0xFE,0x24,0x7E,0x24,0x40,0xA4,0x7F,0xA4,0x3F,0x24,0x22,
	0x24,0x22,0xFF,0x23,0xFF,0x0F,0x22,0x1C,0x2E,0x30,0x2C,0x60,0x20,0xF8,0x20,0xF8,/*"武",0*/
	0x00,0x00,0x00,0x00,0x00,0xFF,0x7F,0xFF,0x7F,0x49,0x49,0x49,0x49,0x49,0x49,0x49,
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	0x00,0x00,0x00,0x00,0x00,0x00,0x00,0x00,0x00,0x00,0x00,0x00,0x00,0x00,0x00,0x00,
};

uint8_t code school_en_name_font[] =
{

	0x00,0x00,0x00,0x00,0x00,0x00,0x00,0x00,0x00,0x00,0x00,0x00,0x00,0x00,0x00,0x00,
	0x00,0x00,0x00,0x00,0x00,0x00,0x00,0x00,0x00,0x00,0x00,0x00,0x00,0x00,0x00,0x00,
	0x00,0x00,0x00,0x00,0x00,0x00,0x00,0x00,0x00,0x00,0x00,0x00,0x00,0x00,0x00,0x00,
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	0x80,0x00,0x80,0x81,0x80,0x86,0x00,0x78,0x00,0x18,0x80,0x06,0x80,0x01,0x80,0x00,/*"y",31*/

};

typedef struct 
{
	uint8_t *page_p;
	uint16_t byte_size;
}Page_Directory;

Page_Directory code page_directory[PAGE_MAX_COUNT] = 
{
	{school_ch_name_font,sizeof(school_ch_name_font)},
	{school_en_name_font,sizeof(school_en_name_font)},
	{school_log_picture,sizeof(school_log_picture)},	
};
static uint16_t move_level_index = 0;	//水平移动索引
static int8_t move_vertical_index = 0; //垂直移动索引

static uint8_t display_move_speed = 50;	//移动速度
static uint8_t current_page_index = 0;	//当前页面的索引
static uint8_t current_button_value = 0;

bit level_move_enable	= 1; //水平移动开关使能	
bit vertical_move_enable = 0; //垂直移动开关使能

bit level_move_direction = 0;	//0从左到右 1从右到左 
bit vertical_move_direction = 0;//0从下到上 1从上到下 

void IO_Init()
{
	SH_CP_PIN = 0;
	DS_PIN = 0;
	ST_CP_PIN = 0;
	
	HC154_ABCD_PIN = 0;
	
	KEY_ALL_PIN = 0xff;
}

void Timer0Init(void)	//1毫秒@12.000MHz
{
	EA = 1;				//开启总中断

	AUXR &= 0x7F;		//定时器时钟12T模式
	TMOD &= 0xF0;		//设置定时器模式
	TMOD |= 0x01;		//设置定时器模式
	TL0 = 0x18;			//设置定时初值
	TH0 = 0xFC;			//设置定时初值
	ET0 = 1;			//开启定时器中断
	TF0 = 0;			//清除TF0标志
	TR0 = 1;			//定时器0开始计时
}

/*按键处理过程*/
void key_process()
{
	if(current_button_value == 0)
	{
		return ;
	}
	
	if((current_button_value & 0x01))
	{
		move_level_index = 0;
		move_vertical_index = 0;
		level_move_enable = 1;
		vertical_move_enable = 0;
		
		current_page_index++;
		if(current_page_index >= PAGE_MAX_COUNT)
		{
			current_page_index = 0;
		}
	}
	
	if((current_button_value & 0x02))
	{
		display_move_speed -= 20;
		display_move_speed &= 127;
	}

	if((current_button_value & 0x04))
	{
		level_move_direction = ~level_move_direction;
	}
	
	if((current_button_value & 0x08))
	{
		level_move_enable = ~level_move_enable;
	}

	if((current_button_value & 0x10))
	{
		vertical_move_direction = ~vertical_move_direction;
	}
	
	if((current_button_value & 0x20))
	{
		vertical_move_enable = ~vertical_move_enable;
	}
	current_button_value = 0;
}

/*按键扫描*/
void key_scan()
{
	static uint8_t last_key_value = 0xff;
	uint8_t current_key_value = P1;
	
	if(current_key_value == last_key_value)	//没有按键按下 或者按键没有松开
	{
		return ;
	}
	if(current_key_value == 0xff)
		current_button_value = current_key_value - last_key_value;
	last_key_value = current_key_value;	
}

void main()
{
	IO_Init();
	Timer0Init();
	while(1)
	{
		key_process();
	}
}

void Time0interrupt() interrupt 1
{
	static uint8_t time_index = 0;
	const uint8_t *picture_data = page_directory[current_page_index].page_p + move_level_index * ROW_BYTE;

	TL0 = 0x18;		//设置定时初值
	TH0 = 0xFC;		//设置定时初值
	
	led_picture_scan(picture_data,move_vertical_index);
	
	key_scan();
	
	time_index++;
	
	if(time_index >= display_move_speed)
	{	
		time_index = 0;
	
		if(level_move_enable)
		{
			if(level_move_direction)
				move_level_index--;
			else
				move_level_index++; 
		}

		if(move_level_index > page_directory[current_page_index].byte_size / ROW_BYTE - COLUMN_MAX)
		{
			if(level_move_direction)
				move_level_index = page_directory[current_page_index].byte_size / ROW_BYTE - COLUMN_MAX - 1;
			else
				move_level_index = 0;
		}		
		
		if(vertical_move_enable)
		{
			if(vertical_move_direction)
				move_vertical_index--;
			else
				move_vertical_index++; 			
		}
		
		if(move_vertical_index > ROW_MAX || move_vertical_index < -ROW_MAX)
		{
			move_vertical_index = 0;
		}
	}
	

}
